
// Backlight (pin 10) connected to +3.3 V
// MISO (pin 9) unconnected 
// SCK (pin 8) connected to PA2 (SSI0Clk)
// MOSI (pin 7) connected to PA5 (SSI0Tx)
// TFT_CS (pin 6) connected to PA3 (SSI0Fss)
// CARD_CS (pin 5) unconnected
// Data/Command (pin 4) connected to PA6 (GPIO)
// RESET (pin 3) connected to PA7 (GPIO)
// VCC (pin 2) connected to +3.3 V
// Gnd (pin 1) connected to ground
#include <stdio.h>
#include <stdint.h>
#include "ST7735.h"
#include "PLL.h"
#include "inc/tm4c123gh6pm.h"
#include "Timer.h"
#include "LCDscreen.h"
#include "alarmsound.h"
#include "GPIOswitches.h"

/* These are all of the definitions of the global variables for lab 3. */

//the array containing the background bitmap
const uint16_t clock_face[] = {
0x0000, 0x0000, 0x0000, 0x0000, 0x0000, 0x0000, 0x0000, 0x0000, 0x0000, 0x0000, 0x0000, 0x0000, 0x0000, 0x0000, 0x0000, 0x0000, 0x0000, 
0x0000, 0x0000, 0x0000, 0x0000, 0x0000, 0x0000, 0x0000, 0x0000, 0x0000, 0x0000, 0x0000, 0x0000, 0x0000, 0x0000, 0x0000, 0x0000, 
0x0000, 0x0000, 0x0000, 0x0000, 0x0000, 0xFFFF, 0xFFFF, 0xFFFF, 0xFFFF, 0xFFFF, 0x0000, 0x0000, 0x0000, 0x0000, 0x0000, 0x0000, 
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0x0000, 0x0000, 0x0000, 0x0000, 0x0000, 0x0000, 0x0000, 0x0000, 0x0000, 0x0000, 0x0000, 0x0000, 0x0000, 0x0000, 0x0000
};
//the array containing the background bitmap

const uint8_t min_hand_xpos[60] = {64, 67, 69, 72, 75, 77, 79, 81, 83, 85, 87, 88, 89, 89, 90, 90, 90, 89, 89, 88, 87, 85, 
83, 81, 79, 77, 75, 72, 69, 67, 64, 61, 59, 56, 53, 51, 49, 47, 45, 43, 41, 40, 
39, 39, 38, 38, 38, 39, 39, 40, 41, 43, 45, 47, 49, 51, 53, 56, 59, 61};  //contains the x value of the ending position for each minute/second hand value
const uint8_t min_hand_ypos[60] = {54, 54, 55, 55, 56, 57, 59, 61, 63, 65, 67, 69, 72, 75, 77, 80, 83, 85,
  88, 91, 93, 95, 97, 99, 101, 103, 104, 105, 105, 106, 106, 106, 105, 105, 104, 103, 101, 99, 97, 95, 93, 91, 88, 85, 83, 80, 77, 75, 72, 
	69, 67, 65, 63, 61, 59, 57, 56, 55, 55, 54};  //contains the y value of the ending position for each minute/second hand value
const uint8_t hour_hand_ypos[96] = {64, 64, 65, 66, 67, 69, 70, 72, 74, 76, 78, 80, 82, 84, 86, 88, 90, 91, 93, 94, 95, 95,
  96, 96 ,96, 95, 95, 94, 93, 91, 90, 88, 86, 84,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 95,
  96, 96 ,96, 95, 95, 94, 93, 91, 90, 88, 86, 84, 82, 80, 78, 76, 74, 72, 70, 69, 67, 66, 65, 64, 64}; //contains the x value of the ending position for each hour hand value
const uint8_t hour_hand_xpos[96] = {64, 66, 68, 70, 72, 74, 75, 77, 78, 79, 79, 80, 80, 80, 79, 79, 78, 77, 75, 74, 72, 70, 
  68, 66, 64, 62, 60, 58, 56, 54, 53, 51, 50, 49,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 80, 
  79, 79, 78, 77, 75, 74, 72, 70, 68, 66, 64, 62,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 62,}; //contains the y value of the ending position for each hour hand value
uint16_t clock_color; //color of the clock face, min, and hour hands

uint16_t current_sec; //current seconds value
uint16_t current_min; //current minutes value
uint16_t current_hour; //current hours value
uint8_t sec_flag; //seconds changed flag
uint8_t min_flag; //minutes changed flag
uint8_t hour_flag; //hours changed flag
uint16_t alarm_sec; //seconds alarm value
uint16_t alarm_min; //minutes alarm value
uint16_t alarm_hour; //hours alarm value
uint8_t alarm_flag; //alarm enabled flag

#define PD0       (*((volatile uint32_t *)0x40007001))
#define PD1       (*((volatile uint32_t *)0x40007002))

void setAlarm(void){
	uint16_t hour = 0, min = 0, sec = 0;
	ST7735_PlotClear(0, 159);
	printf("%02i:%02i:%02i", hour/4, min, sec);
	ST7735_SetCursor(0,0);
	//while(!switch1){
	//if(switch2){
	 while((GPIO_PORTB_DATA_R & 0x01) != 0x00){
	  if((GPIO_PORTB_DATA_R & 0x02) == 0x00){
		  while((GPIO_PORTB_DATA_R & 0x02) == 0x00){} 
	    hour++;
	    printf("%02i", hour);
	    ST7735_SetCursor(0,0);
		}
	}
	//else if(switch3){
	while((GPIO_PORTB_DATA_R & 0x01) == 0x00){}
	ST7735_SetCursor(3,0);
	while((GPIO_PORTB_DATA_R & 0x01) != 0x00){
	  if((GPIO_PORTB_DATA_R & 0x02) == 0x00){
		  while((GPIO_PORTB_DATA_R & 0x02) == 0x00){} 
	    min++;
	    printf("%02i", min);
	    ST7735_SetCursor(3,0);
		}
//	  else if(!PD2){
//		  while(!PD2){}
//	    min--;
//	    printf("%02i", min);
//	    ST7735_SetCursor(3,0);
//		}
	}
	while((GPIO_PORTB_DATA_R & 0x01) == 0x00){}
	ST7735_SetCursor(6,0);
	while((GPIO_PORTB_DATA_R & 0x01) != 0x00){
	  if((GPIO_PORTB_DATA_R & 0x02) == 0x00){
		  while((GPIO_PORTB_DATA_R & 0x02) == 0x00){} 
	    sec++;
	    printf("%02i", sec);
	    ST7735_SetCursor(6,0);
		}
	}
	alarm_hour = hour;
	alarm_min = min;
	alarm_sec = sec;
}

void setTime(void){
	uint16_t hour = 0, min = 0, sec = 0;
	ST7735_PlotClear(0, 159);
	printf("%02i:%02i:%02i", hour/4, min, sec);
	ST7735_SetCursor(0,0);
	//while(!switch1){
	//if(switch2){
	 while((GPIO_PORTB_DATA_R & 0x01) != 0x00){
	  if((GPIO_PORTB_DATA_R & 0x02) == 0x00){
		  while((GPIO_PORTB_DATA_R & 0x02) == 0x00){} 
	    hour++;
	    printf("%02i", hour);
	    ST7735_SetCursor(0,0);
		}
	}
	//else if(switch3){
	while((GPIO_PORTB_DATA_R & 0x01) == 0x00){}
	ST7735_SetCursor(3,0);
	while((GPIO_PORTB_DATA_R & 0x01) != 0x00){
	  if((GPIO_PORTB_DATA_R & 0x02) == 0x00){
		  while((GPIO_PORTB_DATA_R & 0x02) == 0x00){} 
	    min++;
	    printf("%02i", min);
	    ST7735_SetCursor(3,0);
		}
//	  else if(!PD2){
//		  while(!PD2){}
//	    min--;
//	    printf("%02i", min);
//	    ST7735_SetCursor(3,0);
//		}
	}
	while((GPIO_PORTB_DATA_R & 0x01) == 0x00){}
	ST7735_SetCursor(6,0);
	while((GPIO_PORTB_DATA_R & 0x01) != 0x00){
	  if((GPIO_PORTB_DATA_R & 0x02) == 0x00){
		  while((GPIO_PORTB_DATA_R & 0x02) == 0x00){} 
	    sec++;
	    printf("%02i", sec);
	    ST7735_SetCursor(6,0);
		}
	}
	current_hour = hour;
	current_min = min;
	current_sec = sec;
	
}

int main(void){
  int BackData;
	uint16_t old_hour, old_min, old_sec;
	
	PLL_Init();
  SysTick_Init();
  LCDscreen_Init();
  GPIOswitches_Init();
  alarmsound_Init();
  secTimer_Init();
  soundTimer_Init();
  
  //Activating port F to use as a debugging tool for watching ISR times
  SYSCTL_RCGCGPIO_R |= 0x20;       // activate port F
  while((SYSCTL_PRGPIO_R&0x20)==0){};
  GPIO_PORTF_DIR_R |= 0x1E;        // make PF3-1 output (PF3-0 built-in LEDs)
  GPIO_PORTF_AFSEL_R &= ~0x1E;     // disable alt funct on PF4-1
  GPIO_PORTF_DEN_R |= 0x1E;        // enable digital I/O on PF4-1
                                   // configure PF4-1 as GPIO
  GPIO_PORTF_PCTL_R = (GPIO_PORTF_PCTL_R&0xFFFF000F)+0x00000000;
  GPIO_PORTF_AMSEL_R = 0;          // disable analog functionality on PF
  BackData = 0;                    // allow time to finish activating
  
		
	//Clock face tests
	LCDdraw_background();
	clock_color = ST7735_Color565(255, 255, 255);
	for(int i = 0; i < 59; i++){
		current_sec = i;
		LCDupdate_sec(current_sec-1);
	}
	for(int i = 0; i < 47; i++){
		current_hour = i;
		LCDupdate_hour(current_hour-1);
	}
	
	while(1){
		if(sec_flag){
			LCDupdate_sec(old_sec);
			old_sec = current_sec;
			sec_flag = 0;
		}
		if(min_flag){
			LCDupdate_min(old_min);
			old_min = current_min;
			min_flag = 0;
		}
		if(hour_flag){
			LCDupdate_hour(old_hour);
			old_hour = current_hour;
			hour_flag = 0;
		}
		if((GPIO_PORTB_DATA_R & 0x02) == 0x00){  //PB1 is the set time button
		  while((GPIO_PORTB_DATA_R & 0x02) == 0x00){}
			setTime();	
		}
		else if((GPIO_PORTB_DATA_R & 0x01) == 0x00){ //PB0 is the set alarm time button
		  while((GPIO_PORTB_DATA_R & 0x01) == 0x00){}
			setAlarm();
		}
	}
}
